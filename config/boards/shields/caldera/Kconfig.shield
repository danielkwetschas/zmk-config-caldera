## config/boards/shields/caldera/Kconfig.shield
```kconfig
config SHIELD_RAPTAP_LEFT
    def_bool $(shields_list_contains,Raptap_left)

config SHIELD_RAPTAP_RIGHT
    def_bool $(shields_list_contains,Raptap_right)
```
